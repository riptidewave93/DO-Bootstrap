## do-bootstrap/configs/do-bootstrap_defconfig
```kconfig
# Architecture
BR2_x86_64=y

# Toolchain
BR2_GCC_VERSION_7_X=y
BR2_TOOLCHAIN_BUILDROOT_WCHAR=y

# Linux headers same as kernel, a 4.18 series
BR2_PACKAGE_HOST_LINUX_HEADERS_CUSTOM_4_18=y

# System configuration
BR2_TARGET_GENERIC_HOSTNAME="DO-Bootstrap"
BR2_TARGET_GENERIC_ISSUE="Welcome to DO-Bootstrap!"

# Build Scripts
BR2_ROOTFS_POST_FAKEROOT_SCRIPT="$(BR2_EXTERNAL_DO_BS_PATH)/board/do-bootstrap/post-fakeroot.sh"
BR2_ROOTFS_POST_BUILD_SCRIPT="$(BR2_EXTERNAL_DO_BS_PATH)/board/do-bootstrap/post-build.sh"
BR2_ROOTFS_POST_IMAGE_SCRIPT="$(BR2_EXTERNAL_DO_BS_PATH)/board/do-bootstrap/post-image.sh"

# Kernel
BR2_LINUX_KERNEL=y
BR2_LINUX_KERNEL_CUSTOM_VERSION=y
BR2_LINUX_KERNEL_CUSTOM_VERSION_VALUE="4.18.20"
BR2_LINUX_KERNEL_USE_CUSTOM_CONFIG=y
BR2_LINUX_KERNEL_CUSTOM_CONFIG_FILE="$(BR2_EXTERNAL_DO_BS_PATH)/board/do-bootstrap/kernel.config"

# Filesystem
BR2_ROOTFS_OVERLAY="$(BR2_EXTERNAL_DO_BS_PATH)/board/do-bootstrap/fs-overlay"
BR2_TARGET_ROOTFS_CPIO=y
BR2_TARGET_ROOTFS_CPIO_XZ=y
# BR2_TARGET_ROOTFS_TAR is not set

# System Settings
BR2_ROOTFS_DEVICE_CREATION_DYNAMIC_EUDEV=y
BR2_SYSTEM_BIN_SH_BASH=y

# Image Packages
BR2_PACKAGE_ACPID=y # acpi shutdown events
BR2_PACKAGE_AVAHI=y
BR2_PACKAGE_AVAHI_AUTOIPD=y
BR2_PACKAGE_BUSYBOX_SHOW_OTHERS=y
BR2_PACKAGE_BASH=y
BR2_PACKAGE_BZIP2=y
BR2_PACKAGE_CA_CERTIFICATES=y
BR2_PACKAGE_CURL=y
BR2_PACKAGE_DROPBEAR=y
BR2_PACKAGE_E2FSPROGS=y
BR2_PACKAGE_JQ=y
BR2_PACKAGE_LIBCURL=y # needed by curl
BR2_PACKAGE_LIBICONV=y # needed by parted
BR2_PACKAGE_OPENSSL=y
BR2_PACKAGE_PARTED=y
BR2_PACKAGE_PV=y
BR2_PACKAGE_QEMU=y
BR2_PACKAGE_QEMU_TOOLS=y
BR2_PACKAGE_TAR=y
```
